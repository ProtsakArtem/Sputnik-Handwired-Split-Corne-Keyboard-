## config/boards/shields/scylla/Kconfig.shield
```kconfig
# Scylla shield

config SHIELD_SCYLLA_LEFT
	bool "Scylla Left"
	select SHIELD

config SHIELD_SCYLLA_RIGHT
	bool "Scylla Right"
	select SHIELD
```

## config/west.yml
```yaml
manifest:
  remotes:
    - name: zmkfirmware
      url-base: https://github.com/zmkfirmware
  projects:
    - name: zmk
      remote: zmkfirmware
      revision: zephyr-3.5  # <--- ПРАВИЛЬНА НАЗВА СТАБІЛЬНОЇ ГІЛКИ
      import: app/west.yml
  self:
    path: config
```
